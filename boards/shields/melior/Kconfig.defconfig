## boards/shields/melior/Kconfig.defconfig
```kconfig
# ---------------------
# Snake Dongle
# ---------------------

if SHIELD_MELIOR_CENTRAL_SNAKE

config ZMK_KEYBOARD_NAME
    default "Melior"

if ZMK_BACKLIGHT

config PWM
    default y

config LED_PWM
    default y

endif # ZMK_BACKLIGHT

config ZMK_POINTING
    default y

config ZMK_SPLIT_ROLE_CENTRAL
    default y

choice ZMK_DISPLAY_STATUS_SCREEN
    default ZMK_DISPLAY_STATUS_SCREEN_CUSTOM
endchoice

config ZMK_DISPLAY_STATUS_SCREEN_CUSTOM
    select ZMK_WPM
    imply ZMK_HID_INDICATORS

choice ZMK_DISPLAY_WORK_QUEUE
    default ZMK_DISPLAY_WORK_QUEUE_DEDICATED
endchoice

config LV_Z_VDB_SIZE
	default 64
    
config LV_DPI_DEF
    default 148

config LV_Z_BITS_PER_PIXEL
    default 16

choice ST7789V_PIXEL_FORMAT
    default ST7789V_RGB565
endchoice

choice LV_COLOR_DEPTH
    default LV_COLOR_DEPTH_16
endchoice

endif # Snake Dongle


# ---------------------
# Prospector Dongle
# ---------------------

if SHIELD_MELIOR_CENTRAL_PROSPECTOR

config ZMK_KEYBOARD_NAME
    default "Melior"

config ZMK_POINTING
    default y

if ZMK_BACKLIGHT

config PWM
    default y

config LED_PWM
    default y

endif # ZMK_BACKLIGHT

   
config ZMK_SPLIT_ROLE_CENTRAL
    default y

config ZMK_USB
    default y

endif # Prospector Dongle

# ---------------------
# Central Dongle and Central Left
# ---------------------

if SHIELD_MELIOR_CENTRAL_DONGLE || SHIELD_MELIOR_CENTRAL_LEFT 

config ZMK_KEYBOARD_NAME
    default "Melior"

config ZMK_POINTING
    default y

config ZMK_SPLIT_ROLE_CENTRAL
    default y

endif

if ZMK_DISPLAY

config SSD1306
    default y

choice ZMK_DISPLAY_WORK_QUEUE
    default ZMK_DISPLAY_WORK_QUEUE_DEDICATED
endchoice

endif

if LVGL

config LV_Z_VDB_SIZE
    default 64

config LV_DPI_DEF
    default 148

config LV_Z_BITS_PER_PIXEL
    default 1

choice LV_COLOR_DEPTH
    default LV_COLOR_DEPTH_1
endchoice

endif # Central Dongle and Central Left

# ---------------------
# For all the shields
# ---------------------

if SHIELD_MELIOR_CENTRAL_DONGLE || SHIELD_MELIOR_CENTRAL_LEFT || SHIELD_MELIOR_PERIPHERAL_LEFT || SHIELD_MELIOR_PERIPHERAL_RIGHT || SHIELD_MELIOR_CENTRAL_SNAKE || SHIELD_MELIOR_CENTRAL_PROSPECTOR

config ZMK_SPLIT
    default y

config ZMK_BLE
    default y

endif

# ---------------------
# Peripheral Left and Right
# ---------------------

if SHIELD_MELIOR_PERIPHERAL_LEFT || SHIELD_MELIOR_PERIPHERAL_RIGHT 

config ZMK_POINTING
    default y

config SPI
    default y

endif
```

## boards/shields/melior/Kconfig.shield
```kconfig
# Copyright (c) 2020 The ZMK Contributors
# SPDX-License-Identifier: MIT

config SHIELD_MELIOR_CENTRAL_DONGLE
	def_bool $(shields_list_contains,melior_central_dongle)

config SHIELD_MELIOR_CENTRAL_SNAKE
    def_bool $(shields_list_contains,melior_central_snake)

config SHIELD_MELIOR_CENTRAL_LEFT
    def_bool $(shields_list_contains,melior_central_left)

config SHIELD_MELIOR_PERIPHERAL_LEFT
    def_bool $(shields_list_contains,melior_peripheral_left)

config SHIELD_MELIOR_PERIPHERAL_RIGHT
    def_bool $(shields_list_contains,melior_peripheral_right)

config SHIELD_MELIOR_CENTRAL_PROSPECTOR
    def_bool $(shields_list_contains,melior_central_prospector)
```

## config/west.yml
```yaml
manifest:
  remotes:
    - name: zmkfirmware
      url-base: https://github.com/zmkfirmware
    - name: felixJR123
      url-base: https://github.com/felixJR123
  projects:
    - name: zmk
      remote: zmkfirmware
      revision: main
      import: app/west.yml
    - name: module-snake-dongle
      remote: felixJR123                    
      revision: zephyr-4.1  
    - name: module-prospector
      remote: felixJR123                    
      revision: zephyr-4.1                               
  self:
    path: config
    
```
